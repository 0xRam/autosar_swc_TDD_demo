AUTOSAR XML (schema 4-2-2)
package /Company/Components
  swc implementation Controller_imp: programming-language=C, sw-version=1.26.1, used-code-generator=Embedded Coder 7.2 (R2019a) 23-Nov-2018, vendor-id=0, behavior=Controller_InternalBehavior
    code-descriptors:
      code Code
        artifact-descriptors:
          short-label=autosar_swc_controller_c, category=SWSRC
          short-label=autosar_swc_controller_h, category=SWHDR
          short-label=autosar_swc_controller_private_h, category=SWHDR
          short-label=autosar_swc_controller_types_h, category=SWHDR
          short-label=rtwtypes_h, category=SWHDR
    resource consumption RsrcCons_autosar_swc_controller
